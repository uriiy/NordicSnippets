#include "ssd1306.h"
#include <stdint.h>
#include <stdio.h>
#include <nrf.h>

uint8_t LCD_X,LCD_Y;

static const uint8_t LCD_Buffer[][22] = { 
	{0x00, 0x00, 0x00, 0x00, 0x00},// (space)
	{0x00, 0x00, 0x5F, 0x00, 0x00},// !
	{0x00, 0x07, 0x00, 0x07, 0x00},// "
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	{0x08, 0x1C, 0x2A, 0x08, 0x08} // <-
};

static const uint8_t Logo [] = 
{
	0x00, 0x00, 0x00, 0x00, 0x00, 0x00, 0x00, 0x00, 0x00, 0x00, 0x00, 0x00,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 0x00, 
	0x00, 0x00, 0x00, 0x00, 0x00, 0x00, 0x00, 0x00, 0x00, 0x00, 0x00, 0x00,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 0x00, 
	0x00, 0x00, 0x00, 0x00, 0x00, 0x00, 0x00, 0x00, 0x00, 0x00, 0x00, 0x00,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 0x00, 
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	0x00, 0x00, 0x00, 0x00, 0x00, 0x00, 0x00, 0x00, 0x00, 0x00, 0x00, 0x00,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 0x00, 
};

static const uint8_t Logo_1[] =
{ 

};

void LCD_Commmand(uint8_t ControByte, uint8_t DataByte)
{
	i2c_write(ControByte, DataByte);
}
void LCD_Goto(uint8_t x, uint8_t y)
{
	LCD_X = x;
	LCD_Y = y;
	// send a bunch of data in one xmission
	LCD_Commmand(COMAND, 0xB0 + y);//set page address
	LCD_Commmand(COMAND, x & 0xf);//set lower column address
	LCD_Commmand(COMAND,0x10 | (x >> 4));//set higher column address
}
void LCD_Clear(void)
{
	uint16_t i;
	uint16_t x=0;
	uint16_t y=0;
	LCD_Goto(0,0);
	
	for (i=0; i<(SSD1306_LCDWIDTH*SSD1306_LCDHEIGHT/8); i++) //(SSD1306_LCDWIDTH*SSD1306_LCDHEIGHT/8)
	{
		LCD_Print(' ');
		x ++;
		if(x>SSD1306_LCDWIDTH)
		{
			x =0;
			y++;
			LCD_Goto(0,y);
		}
	}
	LCD_X =SSD1306_DEFAULT_SPACE;
	LCD_Y =0;
}
void LCD_draw8x8(uint8_t * buffer, uint8_t x, uint8_t y)
{
	// send a bunch of data in one xmission
	LCD_Commmand(COMAND, 0xB0 + y);//set page address
	LCD_Commmand(COMAND, x & 0xf);//set lower column address
	LCD_Commmand(COMAND,0x10 | (x >> 4));//set higher column address
 
	for (x=0; x<8; x++)
	{
		LCD_Commmand(DATA, buffer[x]);
  }
}

void LCD_Print(char c)
{
	LCD_draw8x8((uint8_t*)&LCD_Buffer[(c-32)],LCD_X,LCD_Y);
	LCD_X += 8;
	if(LCD_X>SSD1306_LCDWIDTH)
	{
		LCD_X =SSD1306_DEFAULT_SPACE;
	}
}
void LCD_Printf(char* buf)
{
	while (*buf!=0)
	{
		//if((LCD_X>SSD1306_LCDWIDTH)||(LCD_X<5)){LCD_X=SSD1306_DEFAULT_SPACE;}
		LCD_Print(*buf++);
	}
}

void hhh(void){
	uint32_t volatile tmo;
	
	while(1){
		LCD_DrawImage((uint8_t*)&Logo);
		tmo = 10000000;
		while (tmo--);
	}
}
void LCD_DrawImage(uint8_t * buf)
{
	uint16_t i;
	int x=0;
	int y=0;
	LCD_Goto(0,0);
	for (i=0; i<(SSD1306_LCDWIDTH*SSD1306_LCDHEIGHT/8); i++)
	{
		LCD_Commmand(DATA, buf[i]);
		x++;
		if(x>=SSD1306_LCDWIDTH)
		{
			x =0;
			y++;
			LCD_Goto(0,y);
		}
	}
}
